## Documentation/devicetree/bindings/pci/snps,dw-pcie-ep.yaml
```yaml
# SPDX-License-Identifier: GPL-2.0
%YAML 1.2
---
$id: http://devicetree.org/schemas/pci/snps,dw-pcie-ep.yaml#
$schema: http://devicetree.org/meta-schemas/core.yaml#

title: Synopsys DesignWare PCIe endpoint interface

maintainers:
  - Jingoo Han <jingoohan1@gmail.com>
  - Gustavo Pimentel <gustavo.pimentel@synopsys.com>

description: |
  Synopsys DesignWare PCIe host controller endpoint

# Please create a separate DT-schema for your DWC PCIe Endpoint controller
# and make sure it's assigned with the vendor-specific compatible string.
select:
  properties:
    compatible:
      const: snps,dw-pcie-ep
  required:
    - compatible

allOf:
  - $ref: /schemas/pci/pci-ep.yaml#
  - $ref: /schemas/pci/snps,dw-pcie-common.yaml#

properties:
  reg:
    description:
      DBI, DBI2 reg-spaces and outbound memory window are required for the
      normal controller functioning. iATU memory IO region is also required
      if the space is unrolled (IP-core version >= 4.80a).
    minItems: 2
    maxItems: 5

  reg-names:
    minItems: 2
    maxItems: 5
    items:
      oneOf:
        - $ref: /schemas/pci/snps,dw-pcie-common.yaml#/definitions/reg-names
        - $ref: '#/definitions/reg-names'
        - deprecated: true
          oneOf:
            - description: See native 'elbi/app' CSR region for details.
              enum: [ link ]
            - description: See native 'atu' CSR region for details.
              enum: [ atu_dma ]
    allOf:
      - contains:
          const: dbi
      - contains:
          const: addr_space

  interrupts:
    description:
      There is no mandatory IRQ signals for the normal controller functioning,
      but in addition to the native set the platforms may have a link- or
      PM-related IRQs specified.
    minItems: 1
    maxItems: 20

  interrupt-names:
    minItems: 1
    maxItems: 20
    items:
      $ref: /schemas/pci/snps,dw-pcie-common.yaml#/definitions/interrupt-names

  max-functions:
    maximum: 32

required:
  - compatible
  - reg
  - reg-names

additionalProperties: true

definitions:
  reg-names:
    description:
      DWC PCIe Endpoint specific CSR space names.
    oneOf:
      - description:
          Outbound iATU-capable memory-region which will be used to
          generate various application-specific traffic on the PCIe bus
          hierarchy. It's usage scenario depends on the endpoint
          functionality, for instance it can be used to create MSI(X)
          messages.
        const: addr_space

examples:
  - |
    pcie-ep@dfd00000 {
      compatible = "snps,dw-pcie-ep";
      reg = <0xdfc00000 0x0001000>, /* IP registers 1 */
            <0xdfc01000 0x0001000>, /* IP registers 2 */
            <0xd0000000 0x2000000>; /* Configuration space */
      reg-names = "dbi", "dbi2", "addr_space";

      interrupts = <23>, <24>;
      interrupt-names = "dma0", "dma1";

      phys = <&pcie_phy0>, <&pcie_phy1>, <&pcie_phy2>, <&pcie_phy3>;
      phy-names = "pcie0", "pcie1", "pcie2", "pcie3";

      max-link-speed = <3>;
      max-functions = /bits/ 8 <4>;
    };
```

## Documentation/devicetree/bindings/pci/snps,dw-pcie.yaml
```yaml
# SPDX-License-Identifier: GPL-2.0
%YAML 1.2
---
$id: http://devicetree.org/schemas/pci/snps,dw-pcie.yaml#
$schema: http://devicetree.org/meta-schemas/core.yaml#

title: Synopsys DesignWare PCIe interface

maintainers:
  - Jingoo Han <jingoohan1@gmail.com>
  - Gustavo Pimentel <gustavo.pimentel@synopsys.com>

description: |
  Synopsys DesignWare PCIe host controller

# Please create a separate DT-schema for your DWC PCIe Root Port controller
# and make sure it's assigned with the vendor-specific compatible string.
select:
  properties:
    compatible:
      const: snps,dw-pcie
  required:
    - compatible

allOf:
  - $ref: /schemas/pci/pci-bus.yaml#
  - $ref: /schemas/pci/snps,dw-pcie-common.yaml#

properties:
  reg:
    description:
      At least DBI reg-space and peripheral devices CFG-space outbound window
      are required for the normal controller work. iATU memory IO region is
      also required if the space is unrolled (IP-core version >= 4.80a).
    minItems: 2
    maxItems: 5

  reg-names:
    minItems: 2
    maxItems: 5
    items:
      oneOf:
        - $ref: /schemas/pci/snps,dw-pcie-common.yaml#/definitions/reg-names
        - $ref: '#/definitions/reg-names'
        - deprecated: true
          oneOf:
            - description: See native 'elbi/app' CSR region for details.
              enum: [ apb, mgmt, link, ulreg ]
            - description: See native 'atu' CSR region for details.
              enum: [ atu_dma ]
            - description: Syscon-related CSR regions.
              enum: [ smu, mpu ]
    allOf:
      - contains:
          const: dbi
      - contains:
          const: config

  interrupts:
    description:
      At least MSI interrupt signal is supposed to be specified for
      the DWC PCIe host controller.
    minItems: 1
    maxItems: 26

  interrupt-names:
    minItems: 1
    maxItems: 26
    items:
      oneOf:
        - $ref: /schemas/pci/snps,dw-pcie-common.yaml#/definitions/interrupt-names
        - $ref: '#/definitions/interrupt-names'
        - deprecated: true
          oneOf:
            - description: See native "msi" IRQ for details
              enum: [ intr ]
    allOf:
      - contains:
          const: msi

  clocks:
    minItems: 1
    maxItems: 7

  clock-names:
    minItems: 1
    maxItems: 7
    items:
      oneOf:
        - $ref: /schemas/pci/snps,dw-pcie-common.yaml#/definitions/clock-names
        - deprecated: true
          oneOf:
            - description: See native 'dbi' clock for details
              enum: [ pcie, pcie_apb_sys, aclk_dbi ]
            - description: See native 'mstr/slv' clock for details
              enum: [ pcie_bus, pcie_inbound_axi, pcie_aclk, aclk_mst, aclk_slv ]
            - description: See native 'pipe' clock for details
              enum: [ pcie_phy, pcie_phy_ref ]
            - description: See native 'aux' clock for details
              enum: [ pcie_aux ]
            - description: See nativs 'phy_reg' clock for details
              enum: [ pcie_apb_phy, pclk ]

  resets:
    minItems: 1
    maxItems: 10

  reset-names:
    minItems: 1
    maxItems: 10
    items:
      oneOf:
        - $ref: /schemas/pci/snps,dw-pcie-common.yaml#/definitions/reset-names
        - deprecated: true
          oneOf:
            - description: See native 'core' reset for details
              enum: [ apps ]
            - description: See native 'phy' reset for details
              enum: [ pciephy ]
            - description: See native 'pwr' reset for details
              enum: [ turnoff ]

additionalProperties: true

required:
  - compatible
  - reg
  - reg-names

definitions:
  reg-names:
    description:
      DWC PCIe Root Port/Complex specific CSR space names.
    oneOf:
      - description:
          Outbound iATU-capable memory-region which will be used to access
          the peripheral PCIe devices configuration space.
        const: config

  interrupt-names:
    description:
      DWC PCIe Root Port/Complex specific IRQ signal names.
    oneOf:
      - description:
          DSP AXI MSI Interrupt detected. It gets de-asserted when there is
          no more MSI interrupt pending. The interrupt is relevant to the
          iMSI-RX - Integrated MSI Receiver (AXI bridge).
        const: msi
      - description:
          Legacy A/B/C/D interrupt signal. Basically it's triggered by
          receiving a Assert_INT{A,B,C,D}/Desassert_INT{A,B,C,D} message
          from the downstream device.
        pattern: "^int(a|b|c|d)$"
      - description:
          Error condition detected and a bit is set in the Root Error Status
          register of the AER capability. It's asserted when the RC
          internally generated an error or an error message is received by
          the RC.
        const: aer
      - description:
          PME message is received by the port. That means having the PME
          status bit set in the Root Status register (the event is
          supposed to be unmasked in the Root Control register).
        const: pme
      - description:
          Hot-plug event is detected. That is a bit has been set in the
          Slot Status register and the corresponding event is enabled in
          the Slot Control register.
        const: hp
      - description:
          Link Autonomous Bandwidth Status flag has been set in the Link
          Status register (the event is supposed to be unmasked in the
          Link Control register).
        const: bw_au
      - description:
          Bandwidth Management Status flag has been set in the Link
          Status register (the event is supposed to be unmasked in the
          Link Control register).
        const: bw_mg

examples:
  - |
    pcie@dfc00000 {
      compatible = "snps,dw-pcie";
      device_type = "pci";
      reg = <0xdfc00000 0x0001000>, /* IP registers */
            <0xd0000000 0x0002000>; /* Configuration space */
      reg-names = "dbi", "config";
      #address-cells = <3>;
      #size-cells = <2>;
      ranges = <0x81000000 0 0x00000000 0xde000000 0 0x00010000>,
               <0x82000000 0 0xd0400000 0xd0400000 0 0x0d000000>;
      bus-range = <0x0 0xff>;

      interrupts = <25>, <24>;
      interrupt-names = "msi", "hp";
      #interrupt-cells = <1>;

      reset-gpios = <&port0 0 1>;

      phys = <&pcie_phy>;
      phy-names = "pcie";

      num-lanes = <1>;
      max-link-speed = <3>;
    };
```
